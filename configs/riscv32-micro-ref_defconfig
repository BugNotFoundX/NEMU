## configs/riscv32-micro-ref_defconfig
```kconfig
# CONFIG_CC_LTO is not set
CONFIG_DIFFTEST_STORE_COMMIT=y
CONFIG_MICRO_PLATFORM=y
CONFIG_PADDRBITS=32
CONFIG_PC_RESET_OFFSET=0x0
# CONFIG_MEM_RANDOM is not set
# CONFIG_HAS_UART16550 is not set
# CONFIG_HAS_TIMER is not set
# CONFIG_HAS_KEYBOARD is not set
# CONFIG_HAS_VGA is not set
# CONFIG_HAS_AUDIO is not set
# CONFIG_HAS_DISK is not set
# CONFIG_HAS_SDCARD is not set
CONFIG_FPU_NONE=y
CONFIG_SHARE=y
# CONFIG_GUIDED_EXEC is not set
CONFIG_REF_STATUS=y
# CONFIG_DETERMINISTIC is not set
```

## configs/riscv64-micro-ref_defconfig
```kconfig
CONFIG_ISA_riscv64=y
CONFIG_CLINT_MMIO=0x38000000
# CONFIG_RVB is not set
# CONFIG_RVK is not set
# CONFIG_RV_ZICOND is not set
# CONFIG_RV_DEBUG is not set
# CONFIG_RVH is not set
CONFIG_RV_PMP_ACTIVE_NUM=4
CONFIG_PMP_GRANULARITY=2
# CONFIG_RV_PMP_CHECK is not set
# CONFIG_RV_PMA_CHECK is not set
# CONFIG_RV_SVINVAL is not set
# CONFIG_CC_LTO is not set
CONFIG_DIFFTEST_STORE_COMMIT=y
CONFIG_MICRO_PLATFORM=y
CONFIG_PADDRBITS=32
CONFIG_PC_RESET_OFFSET=0x0
# CONFIG_MEM_RANDOM is not set
# CONFIG_HAS_UART16550 is not set
# CONFIG_HAS_TIMER is not set
# CONFIG_HAS_KEYBOARD is not set
# CONFIG_HAS_VGA is not set
# CONFIG_HAS_AUDIO is not set
# CONFIG_HAS_DISK is not set
# CONFIG_HAS_SDCARD is not set
CONFIG_FPU_NONE=y
CONFIG_SHARE=y
# CONFIG_GUIDED_EXEC is not set
CONFIG_REF_STATUS=y
# CONFIG_DETERMINISTIC is not set
```
